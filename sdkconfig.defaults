## sdkconfig.defaults
```kconfig
CONFIG_ESP_MATTER_ENABLE_DATA_MODEL=y
CONFIG_ESP_MATTER_DEVICE_TYPE=0x0301
CONFIG_ESP_MATTER_DEVICE_NAME="Smart Floor Heating"
CONFIG_ESP_MATTER_COMMISSIONABLE_DATA=y
CONFIG_ESP_MATTER_ENABLE_SERVER=y

CONFIG_CHIP_DEVICE_VENDOR_ID=0x131B
CONFIG_CHIP_DEVICE_PRODUCT_ID=0xF00D
CONFIG_CHIP_DEVICE_SOFTWARE_VERSION=1
CONFIG_CHIP_DEVICE_SOFTWARE_VERSION_STRING="1.0"

CONFIG_ADC_ENABLE_DEBUG_LOG=y
CONFIG_PWM_ENABLE_DEBUG_LOG=y
```
